## board/vexriscv/saxon/Kconfig
```kconfig
if TARGET_VEXRISCV_SAXON

config SYS_BOARD
	default "saxon"

config SYS_VENDOR
	default "vexriscv"

config SYS_CPU
	default "generic"

config SYS_CONFIG_NAME
	default "saxon"

config SYS_TEXT_BASE
	default 0x80000000

config BOARD_SPECIFIC_OPTIONS # dummy
	def_bool y
	select GENERIC_RISCV

endif
```

## configs/saxon_arty7_defconfig
```kconfig
CONFIG_RISCV=y
CONFIG_SYS_TEXT_BASE=0x81F00000
CONFIG_NR_DRAM_BANKS=1
CONFIG_SPL=n
CONFIG_DEBUG_UART_BASE=0x10010000
CONFIG_DEBUG_UART_CLOCK=100000000
CONFIG_DEBUG_UART=y
CONFIG_TARGET_VEXRISCV_SAXON=y
CONFIG_SPL_TEXT_BASE=0x81F00000
CONFIG_RISCV_SMODE=y
CONFIG_SPL_RISCV_SMODE=y
# CONFIG_RISCV_ISA_C is not set
CONFIG_DISTRO_DEFAULTS=y
CONFIG_BOOTDELAY=-1
CONFIG_BOOTCOMMAND="bootm 0x803fffc0 0x807fffc0 0x80ff0000"
# CONFIG_SPL_RAW_IMAGE_SUPPORT is not set
# CONFIG_SPL_CRC32_SUPPORT is not set
CONFIG_SPL_OS_BOOT=y
CONFIG_SPL_PAYLOAD=""
CONFIG_SPL_RAM_SUPPORT=y
CONFIG_SPL_RAM_DEVICE=y
CONFIG_CMD_MMC=y
CONFIG_CMD_SPI=y
CONFIG_CMD_TIMER=y
CONFIG_PARTITIONS=y
CONFIG_BLK=y
# CONFIG_SPL_OF_CONTROL is not set
CONFIG_OF_EMBED=y
CONFIG_DEFAULT_DEVICE_TREE="saxon_arty7"
# CONFIG_NET is not set
# CONFIG_OF_TRANSLATE is not set
# CONFIG_SPL_BLK is not set
# CONFIG_CLK is not set
CONFIG_MMC=y
CONFIG_MMC_BROKEN_CD=y
# CONFIG_SPL_DM_MMC is not set
CONFIG_MMC_SPI=y
CONFIG_MMC_SPI_CRC_ON=y
# CONFIG_MMC_QUIRKS is not set
# CONFIG_DM_ETH is not set
CONFIG_DEBUG_UART_VEXRISCV=y
CONFIG_SPI=y
CONFIG_VEXRISCV_SPI=y
CONFIG_VEXRISCV_TIMER=y
# CONFIG_RISCV_TIMER is not set
# CONFIG_EFI_LOADER is not set
#CONFIG_LOG_DEFAULT_LEVEL=7
CONFIG_MMC_TRACE=n
CONFIG_FS_EXT4=y
CONFIG_SYS_MALLOC_F_LEN=0x8000
```

## configs/saxon_defconfig
```kconfig
CONFIG_RISCV=y
CONFIG_SYS_TEXT_BASE=0x80200000
CONFIG_SPL_MMC_SUPPORT=y
CONFIG_NR_DRAM_BANKS=1
CONFIG_SPL=y
CONFIG_DEBUG_UART_BASE=0x10010000
CONFIG_DEBUG_UART_CLOCK=50000000
CONFIG_SPL_LIBDISK_SUPPORT=y
CONFIG_SPL_SPI_SUPPORT=y
CONFIG_DEBUG_UART=y
CONFIG_TARGET_VEXRISCV_SAXON=y
CONFIG_SPL_TEXT_BASE=0x80200000
CONFIG_RISCV_SMODE=y
CONFIG_SPL_RISCV_SMODE=y
# CONFIG_RISCV_ISA_C is not set
CONFIG_DISTRO_DEFAULTS=y
CONFIG_BOOTDELAY=-1
CONFIG_BOOTCOMMAND="bootm 0x803fffc0 0x807fffc0 0x80ff0000"
# CONFIG_SPL_RAW_IMAGE_SUPPORT is not set
CONFIG_SPL_SYS_MALLOC_SIMPLE=y
# CONFIG_SPL_CRC32_SUPPORT is not set
CONFIG_SPL_FS_EXT4=y
CONFIG_SPL_OS_BOOT=y
CONFIG_SPL_PAYLOAD=""
CONFIG_SPL_RAM_SUPPORT=y
CONFIG_SPL_RAM_DEVICE=y
# CONFIG_CMD_CPU is not set
CONFIG_CMD_SPL=y
# CONFIG_CMD_CRC32 is not set
CONFIG_CMD_MMC=y
CONFIG_CMD_SPI=y
CONFIG_CMD_TIMER=y
# CONFIG_SPL_DOS_PARTITION is not set
# CONFIG_ISO_PARTITION is not set
# CONFIG_EFI_PARTITION is not set
# CONFIG_SPL_OF_CONTROL is not set
CONFIG_OF_LIVE=y
CONFIG_OF_EMBED=y
CONFIG_DEFAULT_DEVICE_TREE="saxon"
# CONFIG_NET is not set
# CONFIG_CLK is not set
CONFIG_MMC=y
CONFIG_MMC_BROKEN_CD=y
CONFIG_MMC_SPI=y
# CONFIG_MMC_QUIRKS is not set
# CONFIG_MMC_VERBOSE is not set
# CONFIG_MTD is not set
# CONFIG_DM_ETH is not set
CONFIG_RISCV_SBI_SERIAL=y
CONFIG_DEBUG_UART_RISCV_SBI=y
CONFIG_SPI=y
CONFIG_VEXRISCV_SPI=y
CONFIG_VEXRISCV_TIMER=y
# CONFIG_RISCV_TIMER is not set
# CONFIG_EFI_LOADER is not set
```

## configs/saxon_tang_defconfig
```kconfig
CONFIG_RISCV=y
CONFIG_SYS_TEXT_BASE=0x80200000
CONFIG_NR_DRAM_BANKS=1
CONFIG_DEBUG_UART_BASE=0x10010000
CONFIG_DEBUG_UART_CLOCK=50000000
CONFIG_DEBUG_UART=y
CONFIG_TARGET_VEXRISCV_SAXON=y
CONFIG_RISCV_SMODE=y
# CONFIG_RISCV_ISA_C is not set
CONFIG_DISTRO_DEFAULTS=y
CONFIG_BOOTDELAY=-1
CONFIG_BOOTCOMMAND="bootm 0x803fffc0 0x807fffc0 0x80ff0000"
# CONFIG_CMD_CPU is not set
# CONFIG_CMD_CRC32 is not set
CONFIG_CMD_MMC=y
CONFIG_CMD_SPI=y
CONFIG_CMD_TIMER=y
# CONFIG_ISO_PARTITION is not set
# CONFIG_EFI_PARTITION is not set
CONFIG_OF_LIVE=y
CONFIG_OF_EMBED=y
CONFIG_DEFAULT_DEVICE_TREE="saxon"
# CONFIG_NET is not set
# CONFIG_CLK is not set
CONFIG_MMC=y
CONFIG_MMC_BROKEN_CD=y
CONFIG_MMC_SPI=y
# CONFIG_MMC_QUIRKS is not set
# CONFIG_MMC_VERBOSE is not set
# CONFIG_MTD is not set
# CONFIG_DM_ETH is not set
CONFIG_DEBUG_UART_RISCV_SBI=y
CONFIG_RISCV_SBI_SERIAL=y
CONFIG_SPI=y
CONFIG_VEXRISCV_SPI=y
CONFIG_VEXRISCV_TIMER=y
# CONFIG_RISCV_TIMER is not set
# CONFIG_EFI_LOADER is not set
```

## configs/saxon_ulx3s_defconfig
```kconfig
CONFIG_RISCV=y
CONFIG_SYS_TEXT_BASE=0x81F00000
CONFIG_NR_DRAM_BANKS=1
CONFIG_SPL=n
CONFIG_DEBUG_UART_BASE=0x10010000
CONFIG_DEBUG_UART_CLOCK=50000000
CONFIG_DEBUG_UART=y
CONFIG_TARGET_VEXRISCV_SAXON=y
CONFIG_SPL_TEXT_BASE=0x81F00000
CONFIG_RISCV_SMODE=y
CONFIG_SPL_RISCV_SMODE=y
# CONFIG_RISCV_ISA_C is not set
CONFIG_DISTRO_DEFAULTS=y
CONFIG_BOOTDELAY=2
CONFIG_BOOTCOMMAND="load mmc 0:1 0x80000000 /boot/uImage;load mmc 0:1 0x81EF0000 /boot/dtb;bootm 0x80000000 - 0x81EF0000"
# CONFIG_SPL_RAW_IMAGE_SUPPORT is not set
# CONFIG_SPL_CRC32_SUPPORT is not set
CONFIG_SPL_OS_BOOT=y
CONFIG_SPL_PAYLOAD=""
CONFIG_SPL_RAM_SUPPORT=y
CONFIG_SPL_RAM_DEVICE=y
CONFIG_CMD_MMC=y
CONFIG_CMD_SPI=y
CONFIG_CMD_TIMER=y
CONFIG_PARTITIONS=y
CONFIG_BLK=y
# CONFIG_SPL_OF_CONTROL is not set
CONFIG_OF_EMBED=y
CONFIG_DEFAULT_DEVICE_TREE="saxon_ulx3s"
# CONFIG_NET is not set
# CONFIG_OF_TRANSLATE is not set
# CONFIG_SPL_BLK is not set
# CONFIG_CLK is not set
CONFIG_MMC=y
CONFIG_MMC_BROKEN_CD=y
# CONFIG_SPL_DM_MMC is not set
CONFIG_MMC_SPI=y
CONFIG_MMC_SPI_CRC_ON=y
# CONFIG_MMC_QUIRKS is not set
# CONFIG_DM_ETH is not set
CONFIG_RISCV_SBI_SERIAL=y
CONFIG_DEBUG_UART_RISCV_SBI=y
CONFIG_SPI=y
CONFIG_VEXRISCV_SPI=y
CONFIG_VEXRISCV_TIMER=y
# CONFIG_RISCV_TIMER is not set
# CONFIG_EFI_LOADER is not set
#CONFIG_LOG_DEFAULT_LEVEL=7
CONFIG_MMC_TRACE=n
CONFIG_FS_EXT4=y
CONFIG_FS_FAT=y
CONFIG_FS_FAT_MAX_CLUSTSIZE=65536
CONFIG_FAT_WRITE=y
CONFIG_SYS_MALLOC_F_LEN=0x8000
CONFIG_ENV_IS_IN_FAT=y
CONFIG_ENV_FAT_INTERFACE="mmc"
CONFIG_ENV_FAT_DEVICE_AND_PART="0:auto"
CONFIG_ENV_FAT_FILE="uboot.env"
CONFIG_ENV_IS_IN_EXT4=y
CONFIG_ENV_EXT4_INTERFACE="mmc"
CONFIG_ENV_EXT4_DEVICE_AND_PART="0:auto"
CONFIG_ENV_EXT4_FILE="/boot/uboot.env"
CONFIG_CMD_EXT4_WRITE=y
```
